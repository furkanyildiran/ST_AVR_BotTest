#include "pcd8544.h"
#define COMMAND 1
#define DATA 0
#define CE_PIN_LOW()    do{*PCD_port_addr &= ~(1 << CE_PIN); asm volatile("NOP\n\tNOP\n\t"::);}while(0)
#define CE_PIN_HIGH()   do{*PCD_port_addr |=  (1 << CE_PIN); asm volatile("NOP\n\t""NOP\n\t"::);}while(0)
#define RST_PIN_LOW()   do{*PCD_port_addr &= ~(1 << RST_PIN);}while(0)
#define RST_PIN_HIGH()  do{*PCD_port_addr |=  (1 << RST_PIN);}while(0)
#define DC_PIN_COMMAD() do{*PCD_port_addr &= ~(1 << DC_PIN); asm volatile("NOP\n\tNOP\n\t"::);}while(0)
#define DC_PIN_DATA()   do{*PCD_port_addr |=  (1 << DC_PIN); asm volatile("NOP\n\tNOP\n\t"::);}while(0)

const uint8_t characters[CHAR_NUMBER][CHAR_WIDTH] PROGMEM ={
	{0x00,0x00,0x00,0x00,0x00},//space
	{0x00,0x00,0x5f,0x00,0x00},//!
	{0x00,0x00,0x07,0x00,0x07},//"
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	{0x44,0x64,0x54,0x4c,0x44} //x
};

static uint8_t DC_PIN = 0, RST_PIN = 0, CE_PIN = 0;
static volatile uint8_t *PCD_port_addr;

static __attribute__((always_inline)) void reset(void);
static void send_command(uint8_t command);
static void send_data(uint8_t data);

static __attribute__((always_inline)) inline void reset(void){
	RST_PIN_LOW();
	_delay_ms(res_low_pulse_width);
	RST_PIN_HIGH();
}

static void send_command(uint8_t command){
	CE_PIN_LOW();
	DC_PIN_COMMAD();
	SPI_transaction(command);
	CE_PIN_HIGH();
}
static void send_data(uint8_t data){
	CE_PIN_LOW();
	DC_PIN_DATA();
	SPI_transaction(data);
	CE_PIN_HIGH();
}
void PCD_init(volatile uint8_t *const port_addr, uint8_t dc_pin, uint8_t rst_pin, uint8_t ce_pin){
	DC_PIN = dc_pin;
	RST_PIN = rst_pin;
	CE_PIN = ce_pin;
	PCD_port_addr = port_addr;
	volatile uint8_t *const DDR_ADDR = (PCD_port_addr + GPIO_DDR_ADDR_OFFSET);
	*DDR_ADDR |= (1 << RST_PIN) | (1 << DC_PIN) | (1 << CE_PIN);
	CE_PIN_HIGH();
	reset();
	_delay_ms(10);
	send_command(func_set(CHIP_ACTIVE, VERTICL_ADDR, EXTND_I_SET));
	send_command(temp_ctrl(TEMP_COEFF1));
	send_command(bias_systm(BIAS4));
	send_command(set_Vop(60));
	send_command(func_set(CHIP_ACTIVE, VERTICL_ADDR, BASIC_I_SET));
	send_command(dsply_ctrl(NORMAL_MODE));
}

void PCD_contrast(uint8_t contrast){
	if(contrast > 70)
	  contrast = 70;
	send_command(func_set(CHIP_ACTIVE, HORZNTL_ADDR, EXTND_I_SET));
	send_command(set_Vop(contrast));
}

void PCD_text(const char *text, uint8_t x, uint8_t line){
	send_command(func_set(CHIP_ACTIVE, HORZNTL_ADDR, BASIC_I_SET));
	send_command(set_x_addr(x));
	send_command(set_y_addr(line));
	for(; *text != '\0'; text++){
		for (uint8_t j = 0; j < CHAR_WIDTH; j++)
			send_data(pgm_read_byte(&characters[(uint8_t)(*text) - INDIS_OFFSET][j]));
	}
}

void PCD_clear(uint8_t x1_coor, uint8_t x2_coor, uint8_t y_line){
	send_command(func_set(CHIP_ACTIVE, HORZNTL_ADDR, BASIC_I_SET));
	send_command(set_x_addr(x1_coor));
	send_command(set_y_addr(y_line));
	for (; x1_coor < x2_coor; x1_coor++)
		send_data(0x00);
}
void PCD_clear_all(void){
	send_command(func_set(CHIP_ACTIVE, HORZNTL_ADDR, BASIC_I_SET));
	send_command(set_x_addr(0));
	send_command(set_y_addr(0));
	for (int16_t i = 0; i < 504; i++){
		send_data(0x00);
	}
}
void PCD_invert(void){
	send_command(func_set(CHIP_ACTIVE, HORZNTL_ADDR, BASIC_I_SET));
	send_command(dsply_ctrl(INV_VID_MODE));
}


